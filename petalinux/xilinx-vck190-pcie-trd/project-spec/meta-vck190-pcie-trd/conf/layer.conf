## petalinux/xilinx-vck190-pcie-trd/project-spec/meta-vck190-pcie-trd/conf/layer.conf
```bitbake
# We have a conf and classes directory, add to BBPATH
BBPATH .= ":${LAYERDIR}"

# We have recipes-* directories, add to BBFILES
BBFILES += " \
	${LAYERDIR}/recipes-*/*.bb \
	${LAYERDIR}/recipes-*/*.bbappend \
	${LAYERDIR}/recipes-*/*/*.bb \
	${LAYERDIR}/recipes-*/*/*.bbappend \
	"

BBFILE_COLLECTIONS += "meta-vck190-pcie-trd"
BBFILE_PATTERN_meta-vck190-pcie-trd = "^${LAYERDIR}/"
BBFILE_PRIORITY_meta-vck190-pcie-trd = "7"
LAYERDEPENDS_meta-vck190-pcie-trd = "petalinux jupyter-layer"
LAYERSERIES_COMPAT_meta-vck190-pcie-trd = "honister"
```
